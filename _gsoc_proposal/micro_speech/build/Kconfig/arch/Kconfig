## _gsoc_proposal/micro_speech/build/Kconfig/arch/Kconfig
```kconfig
# Load Zephyr Arch Kconfig descriptions.
osource "/home/thongp/zephyrproject/zephyr/arch/x86/Kconfig"
osource "/home/thongp/zephyrproject/zephyr/arch/xtensa/Kconfig"
osource "/home/thongp/zephyrproject/zephyr/arch/sparc/Kconfig"
osource "/home/thongp/zephyrproject/zephyr/arch/riscv/Kconfig"
osource "/home/thongp/zephyrproject/zephyr/arch/posix/Kconfig"
osource "/home/thongp/zephyrproject/zephyr/arch/nios2/Kconfig"
osource "/home/thongp/zephyrproject/zephyr/arch/mips/Kconfig"
osource "/home/thongp/zephyrproject/zephyr/arch/arm64/Kconfig"
osource "/home/thongp/zephyrproject/zephyr/arch/arm/Kconfig"
osource "/home/thongp/zephyrproject/zephyr/arch/arc/Kconfig"
```

## _gsoc_proposal/micro_speech/build/Kconfig/boards/Kconfig
```kconfig
# Load Zephyr board Kconfig descriptions.
osource "/home/thongp/zephyrproject/zephyr/boards/qemu/xtensa/Kconfig"
```

## _gsoc_proposal/micro_speech/build/Kconfig/boards/Kconfig.defconfig
```kconfig
# Load Zephyr board defconfig descriptions.
osource "/home/thongp/zephyrproject/zephyr/boards/qemu/xtensa/Kconfig.defconfig"
```

## build/Kconfig/boards/Kconfig.defconfig
```kconfig
# Load Zephyr board defconfig descriptions.
osource "/home/thongp/zephyrproject/zephyr/boards/qemu/x86/Kconfig.defconfig"
```

## build/Kconfig/boards/Kconfig.qemu_x86
```kconfig
# Load board Kconfig descriptions.
osource "/home/thongp/zephyrproject/zephyr/boards/qemu/x86/Kconfig.qemu_x86"
```

## build/Kconfig/boards/Kconfig.sysbuild
```kconfig
# Load Sysbuild board Kconfig descriptions.
osource "/home/thongp/zephyrproject/zephyr/boards/qemu/x86/Kconfig.sysbuild"
```

## micro_speech/build/Kconfig/arch/Kconfig
```kconfig
# Load Zephyr Arch Kconfig descriptions.
osource "/home/thongp/gsoc/zephyr/arch/x86/Kconfig"
osource "/home/thongp/gsoc/zephyr/arch/xtensa/Kconfig"
osource "/home/thongp/gsoc/zephyr/arch/sparc/Kconfig"
osource "/home/thongp/gsoc/zephyr/arch/riscv/Kconfig"
osource "/home/thongp/gsoc/zephyr/arch/posix/Kconfig"
osource "/home/thongp/gsoc/zephyr/arch/nios2/Kconfig"
osource "/home/thongp/gsoc/zephyr/arch/mips/Kconfig"
osource "/home/thongp/gsoc/zephyr/arch/arm64/Kconfig"
osource "/home/thongp/gsoc/zephyr/arch/arm/Kconfig"
osource "/home/thongp/gsoc/zephyr/arch/arc/Kconfig"
```

## micro_speech/build/Kconfig/boards/Kconfig
```kconfig
# Load Zephyr board Kconfig descriptions.
osource "/home/thongp/gsoc/zephyr/boards/qemu/xtensa/Kconfig"
```

## micro_speech/build/Kconfig/boards/Kconfig.defconfig
```kconfig
# Load Zephyr board defconfig descriptions.
osource "/home/thongp/gsoc/zephyr/boards/qemu/xtensa/Kconfig.defconfig"
```

## micro_speech/build/Kconfig/boards/Kconfig.qemu_xtensa
```kconfig
# Load board Kconfig descriptions.
osource "/home/thongp/gsoc/zephyr/boards/qemu/xtensa/Kconfig.qemu_xtensa"
```

## micro_speech/build/Kconfig/boards/Kconfig.sysbuild
```kconfig
# Load Sysbuild board Kconfig descriptions.
osource "/home/thongp/gsoc/zephyr/boards/qemu/xtensa/Kconfig.sysbuild"
```

## micro_speech_openamp/build/Kconfig/boards/Kconfig.sysbuild
```kconfig
# Load Sysbuild board Kconfig descriptions.
osource "/home/thongp/zephyrproject/zephyr/boards/nxp/imx8mp_evk/Kconfig.sysbuild"
```

## micro_speech_qemu/build/Kconfig/boards/Kconfig.sysbuild
```kconfig
# Load Sysbuild board Kconfig descriptions.
osource "/home/thongp/zephyrproject/zephyr/boards/qemu/xtensa/Kconfig.sysbuild"
```

## proposal/micro_speech/build/Kconfig/boards/Kconfig.qemu_xtensa
```kconfig
# Load board Kconfig descriptions.
osource "/home/thongp/zephyrproject/zephyr/boards/qemu/xtensa/Kconfig.qemu_xtensa"
```

## read_issue/openamp_rsc_table/build/Kconfig/boards/Kconfig.defconfig
```kconfig
# Load Zephyr board defconfig descriptions.
osource "/home/thongp/zephyrproject/zephyr/boards/nxp/imx8mp_evk/Kconfig.defconfig"
```

## read_issue/openamp_rsc_table/build/Kconfig/boards/Kconfig.imx8mp_evk
```kconfig
# Load board Kconfig descriptions.
osource "/home/thongp/zephyrproject/zephyr/boards/nxp/imx8mp_evk/Kconfig.imx8mp_evk"
```
